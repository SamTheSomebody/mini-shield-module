## boards/shields/mini/Kconfig.defconfig
```kconfig
if SHIELD_MINI_LEFT

# Name must be less than 16 characters long!
config ZMK_KEYBOARD_NAME
    default "Mini by Sam"

config ZMK_SPLIT_ROLE_CENTRAL
    default y

endif

if SHIELD_MINI_LEFT|| SHIELD_MINI_RIGHT

config ZMK_SPLIT
    default y

endif
```

## boards/shields/mini/Kconfig.shield
```kconfig
# No whitespace after the comma or in your part name!
config SHIELD_MINI_LEFT
    def_bool $(shields_list_contains,mini_left)

# No whitespace after the comma or in your part name!
config SHIELD_MINI_RIGHT
    def_bool $(shields_list_contains,mini_right)
```
